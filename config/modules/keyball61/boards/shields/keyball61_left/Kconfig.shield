## config/modules/keyball61/boards/shields/keyball61_left/Kconfig.shield
```kconfig
config SHIELD_KEYBALL61_LEFT
    def_bool $(shields_list_contains,keyball61_left)
```

## config/modules/keyball61/boards/shields/keyball61_right/Kconfig.shield
```kconfig
config SHIELD_KEYBALL61_RIGHT
    def_bool $(shields_list_contains,keyball61_right)
```
