## config/west.yml
```yaml
manifest:
  remotes:
    - name: zmkfirmware
      url-base: https://github.com/zmkfirmware #https://github.com/petejohanson
    - name: luix333
      url-base: https://github.com/Luix333
    - name: badjeff
      url-base: https://github.com/badjeff
  projects:
    - name: zmk
      remote: zmkfirmware
      revision: 641514a97db345f499dd50b0360e594270f008fe # main @ 2026-08-21, keep in sync with .github/workflows/build.yml
      import: app/west.yml
    - name: nice-view-portal
      remote: luix333
      revision: b2852ef8a3edacefa47e196bcb36ee458467a5e6 # main @ 2026-09-13: M165437/nice-view-gem@0a50fe2 + portal_bigger animation
    - name: zmk-input-processor-report-rate-limit
      remote: badjeff
      revision: b056cb135525933743e2627150fb390f9d4b2461 # main @ 2026-03-07
  self:
    path: config
```
